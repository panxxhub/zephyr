## drivers/ethernet/Kconfig.xlnx_gem
```kconfig
#
# Xilinx Processor System Gigabit Ethernet controller (GEM) driver
# configuration options
#
# Copyright (c) 2021, Weidmueller Interface GmbH & Co. KG
# SPDX-License-Identifier: Apache-2.0
#

menuconfig ETH_XLNX_GEM
	bool "Xilinx GEM Ethernet driver"
	default y
	depends on DT_HAS_XLNX_GEM_ENABLED
	depends on !QEMU_TARGET || (QEMU_TARGET && NET_QEMU_ETHERNET)
	select NOCACHE_MEMORY if ARCH_HAS_NOCACHE_MEMORY_SUPPORT
	select CACHE_MANAGEMENT if DCACHE
	select NET_CHECKSUM_OFFLOAD_SUPPORTED if NET_L2_ETHERNET
	select MDIO if DT_HAS_XLNX_GEM_MDIO_ENABLED
	help
	  Enable Xilinx GEM Ethernet driver.

config ETH_NIC_MODEL
	string
	default "cadence_gem"
	depends on ETH_XLNX_GEM
	help
	  Value of the -nic parameter to be used when starting QEMU.
	  This parameter specifies which type of Ethernet controller
	  shall be simulated by QEMU.

if ETH_XLNX_GEM

config ETH_XLNX_GEM_RX_THREAD
	bool "Deferred GEM work on a driver-owned thread"
	help
	  Run the deferred receive handling of every GEM instance, and the
	  transmit completion handling of those instances which defer it, on a
	  work queue owned by this driver instead of the system work queue.

	  The system work queue is shared with every other subsystem, so GEM
	  receive processing both waits behind unrelated work items and delays
	  them in turn. A driver-owned queue makes the receive cost of this
	  driver schedulable and attributable on its own thread, named "gem_rx".

	  All GEM instances share the one queue, so the order in which a single
	  instance's work items run is unchanged.

config ETH_XLNX_GEM_RX_THREAD_PRIORITY
	int "Priority of the GEM work queue thread"
	default SYSTEM_WORKQUEUE_PRIORITY
	depends on ETH_XLNX_GEM_RX_THREAD
	help
	  Thread priority of the driver-owned GEM work queue. The default
	  matches the system work queue, so enabling the thread on its own
	  changes which thread runs the work, not at which priority.

config ETH_XLNX_GEM_RX_THREAD_STACK_SIZE
	int "Stack size of the GEM work queue thread"
	default 2048
	depends on ETH_XLNX_GEM_RX_THREAD
	help
	  Stack size of the driver-owned GEM work queue thread, in bytes.

config ETH_XLNX_GEM_FRAME_SIZED_CACHE_OPS
	bool "Size GEM cache maintenance to the frame length"
	depends on DCACHE
	help
	  Invalidate and clean only the cache lines a frame actually occupies
	  instead of the whole DMA buffer holding it.

	  The driver reserves a buffer per descriptor, typically 1536 or 2048
	  bytes, but most frames are far shorter, and on a Cortex-A9 with an
	  outer L2 cache every maintenance operation is charged to the one
	  global cache lock the other core shares. Sizing the operation to the
	  frame cuts the work and the lock hold to what the transfer needs.

	  A length is rounded up to the next cache line, so the operation still
	  covers every byte the frame touches. Buffers start on a cache line
	  boundary and their size is a multiple of the line size, which the
	  driver asserts at build time, so the rounded-up span stays inside the
	  buffer it belongs to.

	  When this option is disabled, whole buffers are maintained, which is
	  the historical behaviour.

config ETH_XLNX_GEM_TX_DONE_WORKQ
	bool "Reclaim GEM transmit descriptors outside the interrupt"
	help
	  Handle transmit completion on a work queue for every GEM instance,
	  as if each of them had the handle-tx-in-workq device tree property
	  set.

	  Unless an instance defers it, the driver walks the buffer
	  descriptors of a completed frame inside the interrupt service
	  routine, which makes the cost of the interrupt proportional to the
	  number of descriptors that frame occupies - up to the whole transmit
	  ring. Deferring the walk leaves the service routine with a fixed
	  number of register accesses and one work item submission.

	  The reclamation then runs under the transmit ring semaphore, the
	  protection the driver already uses for this path, rather than under
	  the interrupt masking used when reclaiming inside the service
	  routine. Enable CONFIG_ETH_XLNX_GEM_RX_THREAD as well to keep that
	  work off the system work queue.

	  When this option is disabled, only instances whose device tree asks
	  for it defer transmit completion, which is the historical behaviour.

endif # ETH_XLNX_GEM
```

## drivers/ethernet/mdio/Kconfig.xlnx_gem
```kconfig
# Copyright (c) 2026 Immo Birnbaum
# SPDX-License-Identifier: Apache-2.0

config MDIO_XLNX_GEM
	bool "Xilinx GEM MDIO controller driver"
	default y
	depends on DT_HAS_XLNX_GEM_MDIO_ENABLED
	depends on ETH_XLNX_GEM
	help
	  Enable Xilinx GEM MDIO support.

if MDIO_XLNX_GEM

config MDIO_XLNX_GEM_IDLE_TIMEOUT_US
	int "MDIO idle wait timeout"
	default 1000
	range 100 10000
	help
	  Timeout in microseconds to wait for the GEM MDIO Bus
	  to become idle before or after a read or write operation.
	  A 64-cycle frame at 133 MHz / 224 takes about 108 us.
	  Polls sleep between retries; PHY boot settling belongs in the PHY driver.

endif # MDIO_XLNX_GEM
```

## drivers/sensor/zynq_xadc_ps/Kconfig
```kconfig
# SPDX-FileCopyrightText: Copyright The Zephyr Project Contributors
# SPDX-License-Identifier: Apache-2.0
config ZYNQ_XADC_PS
	bool "Zynq-7000 PS XADC sensor"
	default y
	depends on DT_HAS_XLNX_ZYNQ_XADC_PS_ENABLED
	help
	  Read internal temperature and supply sensors and their extrema through
	  the PS devcfg XADC command/data FIFOs. No PL logic or interrupts needed.
```

## drivers/timer/Kconfig.cortex_a9_private_timer
```kconfig
# Copyright (c) 2026 Moton Intelligent Technology
# SPDX-License-Identifier: Apache-2.0

config CORTEX_A9_PRIVATE_TIMER
	bool "Cortex-A9 MPCore Private Timer"
	depends on CPU_CORTEX_A9
	depends on GIC
	depends on DT_HAS_ARM_CORTEX_A9_TWD_TIMER_ENABLED
	select ARCH_HAS_CUSTOM_BUSY_WAIT
	select TICKLESS_CAPABLE
	select TIMER_HAS_64BIT_CYCLE_COUNTER
	help
	  Per-CPU private timer driver for ARM Cortex-A9 MPCore.

	  Uses the 32-bit per-CPU Private Timer for interrupt generation
	  and the 64-bit SCU Global Timer counter for cycle counting.
	  This avoids the Global Timer compare-register contention that
	  breaks SMP + tickless mode on Cortex-A9.

config TIMEOUT_ANNOUNCE_CPU0
	bool "Announce timeouts only on CPU 0"
	depends on CORTEX_A9_PRIVATE_TIMER && SMP && SCHED_IPI_SUPPORTED
	depends on ARCH_HAS_DIRECTED_IPIS
	select ARM_GIC_DECODE_IAR if GIC_VER < 3
	help
	  Keep secondary CPUs' private timers disabled. Only CPU 0 advances
	  kernel time and executes timeout callbacks. A new earliest timeout
	  on another CPU sends a scheduler IPI to CPU 0 to reprogram its timer.
	  CPU 0 must remain online. Tickless operation on CPU 0 is preserved.

	  Timed waits on secondary CPUs still wake through scheduler IPIs.
	  Timeslices also expire on CPU 0 and request an IPI to the sliced CPU;
	  they do not require a local timer. Busy waits and cycle reads use
	  the shared global counter and are unaffected. A secondary CPU with
	  no timed work needs no timer interrupts.
```

## drivers/watchdog/Kconfig.xlnx_zynq
```kconfig
# Copyright (c) 2026 Xiang Pan
# SPDX-License-Identifier: Apache-2.0
config WDT_XLNX_ZYNQ
	bool "Xilinx Zynq-7000 PS system watchdog"
	default y
	depends on DT_HAS_XLNX_ZYNQ_SWDT_ENABLED
	help
	  PS SWDT with system reset, one timeout channel, and no interrupts.
	  Adopts an FSBL-armed watchdog without disabling it. Stopping the
	  watchdog and pause-on-debug/sleep options are unsupported.
```

## dts/bindings/dma/xlnx,axi-dma-sg.yaml
```yaml
# Copyright (c) 2026 Moton
# SPDX-License-Identifier: Apache-2.0

description: |
  Xilinx AXI DMA with scatter-gather and cyclic BD support.
  Designed for streaming peripherals (FOC, custom IPs) that need
  cyclic BD rings, APP field passthrough, and dynamic SG reconfiguration.

compatible: "xlnx,axi-dma-sg"

include: dma-controller.yaml

properties:
  reg:
    required: true
    description: |
      Three regions: DMA control registers, TX buffer, RX buffer.
      Use reg-names "regs", "tx_buf", "rx_buf".

  reg-names:
    required: true

  interrupts:
    required: true
    description: |
      Two interrupts: TX (MM2S) completion, RX (S2MM) completion.

  "#dma-cells":
    const: 1

  xlnx,addrwidth:
    type: int
    required: true
    enum: [32, 64]
    description: DMA address width.

  xlnx,sg-length-width:
    type: int
    default: 14
    description: |
      Width of the Buffer Length Register in bits (Vivado parameter
      c_sg_length_width).  Determines the maximum transfer size per
      SG descriptor: max_bytes = 2^width - 1.  Valid range 8..26.
      Must match the value configured in the AXI DMA IP core.

  xlnx,sg-cache:
    type: int
    default: 0x3
    enum: [0, 1, 2, 3, 4, 5, 6, 7, 8, 9, 10, 11, 12, 13, 14, 15]
    description: |
      AxCACHE value for the M_AXI_SG port (SG descriptor fetch and
      write-back transactions).  Written to the SG_CTL register at
      offset 0x2C during init.

      After reset SG_CTL defaults to 0x0 (AxCACHE = 0b0000, device
      non-bufferable).  On Zynq-7000, HP-port writes to DDR with
      AxCACHE[1]=0 may be silently dropped by the interconnect,
      preventing BD write-back (CMPLT bit never set, IOC_IRQ never
      fires).

      Common values:
        0x3  — Normal non-cacheable bufferable (default, safe for DDR)
        0xB  — Write-back read-allocate (for ACP coherent access)

      Must be in the range 0..15.

  xlnx,rx-outer-noncacheable:
    type: boolean
    description: |
      The entire CPU mapping of rx_buf is outer-non-cacheable and has no
      cacheable aliases. On Cortex-A, invalidate only L1 for RX payloads,
      bypassing the outer-cache controller and its lock. This property does
      not configure the MMU: the board must provide the matching mapping.
      RX memory must never contain dirty CPU cache lines. Explicit physical
      streaming destinations remain CPU-invisible and are not maintained.

  xlnx,rx-cpu0-owned:
    type: boolean
    description: |
      Only CPU 0 may read the receive buffer. On Zynq-7000, map rx_buf as
      Normal, inner-cacheable, outer-non-cacheable, Non-shareable memory.
      This keeps RX cache maintenance local to CPU 0. Requires
      xlnx,rx-outer-noncacheable and no other CPU mapping or reader of rx_buf.
      Cache invalidation is still required before reading DMA-written bytes.
      On SMP, payload consumers and the system workqueue must be pinned to
      CPU 0; an unpinned or remote consumer is rejected with EXDEV. Metadata
      queries do not grant permission to read the returned CPU address.
      DMA_XLNX_AXI_DMA_SG_CACHE_COHERENT must be disabled.

  dma-channels:
    const: 2
    description: Fixed 2 channels (TX + RX).

dma-cells:
  - channel
```

## dts/bindings/ethernet/phy/motorcomm,yt8531.yaml
```yaml
# Copyright 2026 NXP
# SPDX-License-Identifier: Apache-2.0

description: Motorcomm YT8531 Ethernet PHY

compatible: "motorcomm,yt8531"

include: motorcomm,yt8521.yaml

properties:
  motorcomm,rxc-dly-en:
    type: boolean
    description: |
      Enable the PHY's coarse ~1.9 ns RXC clock delay (EXT 0xA001 bit 8 is an
      active-low disable; the driver clears it when this flag is present and
      sets it otherwise). Enable when the MAC captures RGMII RX with no clock
      delay of its own (e.g. the FPGA ESC ports); leave absent when the RX
      clock path already carries ~2 ns (e.g. Zynq PS GEM).
```

## dts/bindings/sensor/xlnx,zynq-xadc-ps.yaml
```yaml
# SPDX-FileCopyrightText: Copyright The Zephyr Project Contributors
# SPDX-License-Identifier: Apache-2.0

description: |
  Zynq-7000 PS XADCIF internal temperature and supply sensors. The register
  window starts at devcfg (0xf8007000), including the unlock register at
  0x34 and the XADC command/data FIFO interface at 0x100. PCAP clock must
  be enabled by platform initialization and must not exceed 200 MHz.
  This driver owns XADC configuration exclusively; do not access XADC
  through JTAG or PL while it is active. VP/VN and VAUX are not enabled.

compatible: "xlnx,zynq-xadc-ps"
include: sensor-device.yaml
properties:
  reg:
    required: true
```

## dts/bindings/watchdog/xlnx,zynq-swdt.yaml
```yaml
# SPDX-License-Identifier: Apache-2.0

description: |
  Zynq-7000 PS system watchdog. The clock-frequency is the CPU_1x clock
  supplied by the PS clock configuration. Reset output resets the PS;
  no interrupt handler or interrupt-based feeding is used.

compatible: "xlnx,zynq-swdt"

include: base.yaml

properties:
  reg:
    required: true
  clock-frequency:
    type: int
    required: true
    description: Watchdog input clock in Hz (CPU_1x).
```

## soc/xlnx/zynq7000/Kconfig
```kconfig
#
# Copyright (c) 2021 Weidmueller Interface GmbH & Co. KG
# SPDX-License-Identifier: Apache-2.0
#

if SOC_FAMILY_XILINX_ZYNQ7000

config SOC_XLNX_ZYNQ7000_L2_CACHE
	bool "Enable the Zynq-7000 PL310 L2 cache"
	default y
	depends on DCACHE && ARM_AARCH32_MMU
	select CACHE_MANAGEMENT
	select CACHE
	help
	  Enable the shared PL310 before secondary CPUs start and include outer
	  cache maintenance in the cache API. Disable for cache performance comparisons.

rsource "*/Kconfig"

endif # SOC_FAMILY_XILINX_ZYNQ7000
```

## tests/arch/arm/pl310_outer_cache/testcase.yaml
```yaml
# SPDX-License-Identifier: Apache-2.0
tests:
  arch.arm.pl310_outer_cache:
    tags:
      - arch
      - cache
    platform_allow:
      - qemu_cortex_a9
    integration_platforms:
      - qemu_cortex_a9
```

## tests/drivers/dma/xlnx_axi_dma_sg/testcase.yaml
```yaml
# SPDX-License-Identifier: Apache-2.0
tests:
  drivers.dma.xlnx_axi_dma_sg.finite:
    tags:
      - drivers
      - dma
    platform_allow:
      - qemu_cortex_a9
      - native_sim
    integration_platforms:
      - qemu_cortex_a9
```
