## drivers/dma/Kconfig.xlnx_axi_dma_sg
```kconfig
# Copyright (c) 2026 Moton
# SPDX-License-Identifier: Apache-2.0

config DMA_XLNX_AXI_DMA_SG
	bool "Xilinx AXI DMA scatter-gather driver"
	default y
	depends on DT_HAS_XLNX_AXI_DMA_SG_ENABLED && DMA
	help
	  Xilinx AXI DMA driver with scatter-gather cyclic BD support,
	  generic APP field passthrough, and dynamic RX ring reconfiguration.

if DMA_XLNX_AXI_DMA_SG

config DMA_XLNX_AXI_DMA_SG_APP_FIELDS
	bool
	help
	  Enable the device-specific APP-field helper API for SG descriptors.
	  Keep this disabled unless the connected peripheral actually uses the
	  AXI DMA control/status streams.

config DMA_XLNX_AXI_DMA_SG_NUM_TX_BD
	int "Number of TX scatter-gather descriptors"
	default 16
	range 2 256

config DMA_XLNX_AXI_DMA_SG_NUM_RX_BD
	int "Number of RX scatter-gather descriptors"
	default 1024
	range 2 4096

config DMA_XLNX_AXI_DMA_SG_IRQ_THRESHOLD
	int "Default interrupt coalescing threshold"
	default 1
	range 1 255
	help
	  Number of completed descriptors before generating an interrupt.

config DMA_XLNX_AXI_DMA_SG_IRQ_TIMEOUT
	int "Interrupt delay timeout"
	default 16
	range 0 255
	help
	  Timeout in units of 125 * SG clock period. 0 disables.

config DMA_XLNX_AXI_DMA_SG_CACHE_COHERENT
	bool "DMA is cache-coherent with CPU"
	default n
	help
	  If disabled, driver performs explicit cache flush/invalidate
	  on descriptors and data buffers.

endif # DMA_XLNX_AXI_DMA_SG
```

## drivers/ethernet/mdio/Kconfig
```kconfig
# SPDX-License-Identifier: Apache-2.0

source "drivers/ethernet/mdio/Kconfig.xlnx_gem"
source "drivers/ethernet/mdio/Kconfig.xlnx_esc"
```

## drivers/ethernet/mdio/Kconfig.xlnx_esc
```kconfig
# Copyright (c) 2025 Moton Intelligent Equipment
# SPDX-License-Identifier: Apache-2.0

config MDIO_XLNX_ESC
	bool "Xilinx ESC MDIO driver"
	default y
	depends on DT_HAS_XLNX_ESC_MDIO_ENABLED
	help
	  Enable Xilinx EtherCAT Slave Controller MDIO bus driver.
	  This driver provides the standard MDIO bus interface for PHY
	  drivers connected to the ESC's built-in MII management port.
```

## drivers/sdhc/Kconfig.zynq
```kconfig
config XLNX_ZYNQ_SDHC
    bool "XLNX Zynq SDHC Driver"
    depends on DT_HAS_XLNX_ZYNQ_SDHC_ENABLED
    help
	    Enable the XLNX Zynq SDHC Host Controller Driver.

if XLNX_ZYNQ_SDHC
config XLNX_ZYNQ_SDHC_HOST_INTR
	bool "EMMC host controller interrupt mode"
	default y
	help
	  EMMC host controller interrupt mode support.

config XLNX_ZYNQ_SDHC_HOST_DMA
	bool "EMMC host controller DMA mode"
	help
	  EMMC host controller DMA mode support.

config XLNX_ZYNQ_SDHC_HOST_ADMA
	bool "EMMC host controller ADMA mode"
	depends on XLNX_ZYNQ_SDHC_HOST_DMA
	help
	  EMMC host controller ADMA mode support.

config XLNX_ZYNQ_SDHC_HOST_ADMA_DESC_SIZE
	int "EMMC host controller ADMA Descriptor size"
	depends on XLNX_ZYNQ_SDHC_HOST_ADMA
	default 32
	help
	  EMMC host controller ADMA Descriptor size.

config XLNX_ZYNQ_SDHC_HOST_AUTO_STOP
	bool "auto stop command mode"
	default y
	help
	  Auto stop command mode support.

config XLNX_ZYNQ_SDHC_HOST_TUNING
	bool "Host tuning"
	help
	  Host tuning support.

endif
```

## drivers/spi/Kconfig.xlnx_zynq_qspi
```kconfig
# Copyright (c) 2025 Moton Intelligent Equipment
# SPDX-License-Identifier: Apache-2.0

config SPI_XLNX_ZYNQ_QSPI
	bool "Xilinx Zynq-7000 PS QSPI controller"
	default y
	depends on DT_HAS_XLNX_ZYNQ_QSPI_ENABLED
	help
	  SPI controller driver for the Zynq-7000 PS Quad-SPI flash
	  interface at 0xE000D000. Uses polling mode. Pair with
	  jedec,spi-nor child node for flash access.
```

## drivers/usb/udc/Kconfig.zynq
```kconfig
config UDC_ZYNQ
	bool "Xlnx Zynq USB device controller driver"
	default y
	depends on DT_HAS_XLNX_ZYNQ_USB_ENABLED
	help
	  Xlnx Zynq USB device controller driver.

config UDC_ZYNQ_STACK_SIZE
	int "UDC controller driver internal thread stack size"
	depends on UDC_ZYNQ
	default 512
	help
	  Skeleton device controller driver internal thread stack size.

config UDC_ZYNQ_THREAD_PRIORITY
	int "Skeleton controller driver thread priority"
	depends on UDC_ZYNQ
	default 8
	help
	  Skeleton device controller driver thread priority.

config UDC_ZYNQ_MAX_QMESSAGES
	int "UDC ZYNQ maximum number of ISR event messages"
	depends on UDC_ZYNQ
	range 4 64
	default 8
	help
	  zynq maximum number of ISR event messages.

config UDC_ZYNQ_TIMEOUT
	int "UDC ZYNQ timeout in counter"
	depends on UDC_ZYNQ
	default 10000
	help
	  while prime or reset, we check status by polling, 
	  this is the trival timeout counter init value.
```

## dts/bindings/ethernet/mdio/xlnx,esc-mdio.yaml
```yaml
# Copyright (c) 2025 Moton Intelligent Equipment
# SPDX-License-Identifier: Apache-2.0

description: |
  Xilinx ESC (EtherCAT Slave Controller) MDIO bus controller.
  The ESC has a built-in MII management interface at register offset 0x510.
  Each ESC port requires its own MDIO bus instance since the port_select
  field (register 0x512) is not part of the standard MDIO API.

compatible: "xlnx,esc-mdio"

include: mdio-controller.yaml

properties:
  reg:
    required: true
    description: |
      Base address and size of the ESC register block that contains
      the MII management registers (0x510-0x514).

  xlnx,port-id:
    type: int
    required: true
    description: |
      ESC port index (0-3) used in the MII control register's port_select
      field to route MDIO transactions to the correct physical port.
```

## dts/bindings/ethernet/mdio/xlnx,gem-mdio.yaml
```yaml
# Copyright (c) 2025 Moton Intelligent Equipment
# SPDX-License-Identifier: Apache-2.0

description: |
  Xilinx GEM MDIO bus controller.
  The MDIO controller shares the GEM register space. Place this node as
  a sibling of the GEM MAC node at the SoC level, using the same base
  address as the associated GEM controller.

compatible: "xlnx,gem-mdio"

include: mdio-controller.yaml

properties:
  reg:
    required: true
    description: |
      Base address and size of the GEM register block that contains
      the MDIO management registers (PHY_MAINTENANCE, NWCTRL, NWSR).
```

## dts/bindings/sdhc/xlnx,zynq-sdhc.yaml
```yaml
# Copyright (c) 2023, iCNC Precision Metal
# SPDX-License-Identifier: Apache-2.0

description: XLNX Zynq SDHC Controller

compatible: "xlnx,zynq-sdhc"

include: [sdhc.yaml, pinctrl-device.yaml]

properties:
  reg:
    required: true

  clock-frequency:
    type: int
    required: true
    default: 50000000
    description: |
      The clock frequency of the SDHC controller. If not specified, the default
      value is 50000000.
  
  bus-width:
    type: int
    enum:
      - 4
      - 8
    description: |
      The bus width of the SDHC controller. 4 for 4-bit bus, 8 for 8-bit bus.
      If not specified, the default value is 4.
  slot-type:
    type: int
    enum:
      - 1 # SD
      - 2 # mmc
      - 3 # SDIO
      - 4 # SDCOMBO
      - 5 # emmc
    description: |
      The slot type of the SDHC controller. 1 for SD, 2 for mmc, 3 for SDIO,
      4 for SDCOMBO, 5 for emmc. If not specified, the default value is 1.

  no-1-8-v:
    type: boolean
    description: |
      When the external SD card circuit does not support 1.8V, add this
      property to disable 1.8v card voltage of SD card controller.
```

## dts/bindings/serial/xlnx,xuartps.yaml
```yaml
description: Xilinx PS UART

compatible: "xlnx,xuartps"

include: [uart-controller.yaml, pinctrl-device.yaml]

properties:
  reg:
    required: true
  rx-trigger-level:
    type: int
    default: 1
    description: |
      RX FIFO trigger level
  tx-trigger-level:
    type: int
    default: 1
    description: |
      TX FIFO trigger level
```

## dts/bindings/spi/xlnx,zynq-qspi.yaml
```yaml
# Copyright (c) 2025 Moton Intelligent Equipment
# SPDX-License-Identifier: Apache-2.0

description: |
  Xilinx Zynq-7000 PS Quad-SPI controller.
  Directly connected to the boot flash. Supports standard SPI mode
  with manual chip select and manual start for flash programming.

compatible: "xlnx,zynq-qspi"

include: [spi-controller.yaml, pinctrl-device.yaml]

properties:
  reg:
    required: true

  interrupts:
    required: true

  clock-frequency:
    type: int
    required: true
    description: |
      Input reference clock frequency in Hz (typically SPI_REF_CLK
      from the IO PLL, default ~200 MHz on Zynq-7000).
```

## dts/bindings/timer/arm,cortex-a9-twd-timer.yaml
```yaml
description: |
  ARM Cortex-A9 MPCore Timer-Watchdog (TWD) Private Timer.

  This is the per-CPU 32-bit down-counter in the Cortex-A9 MPCore SCU
  peripheral block.  Each core has its own independent timer instance at
  the same MMIO address (hardware-banked), so there is no cross-CPU
  contention on compare/reload registers.

  The driver pairs this per-CPU interrupt source with a read-only view of
  the 64-bit SCU Global Timer counter for cycle-accurate timekeeping,
  solving the Global Timer compare-register contention that breaks
  SMP + tickless on Cortex-A9.

compatible: "arm,cortex-a9-twd-timer"

include: base.yaml

properties:
  reg:
    required: true
    description: |
      Base address and size of the Private Timer register block.
      On Zynq-7000 this is 0xF8F00600, size 0x20.

  interrupts:
    required: true
    description: |
      Private Timer interrupt (GIC PPI 29).

  clock-frequency:
    type: int
    description: |
      Timer input clock frequency in Hz.  Typically PERIPHCLK, which is
      CPU_CLK / 2 on Zynq-7000 (e.g. 333333333 for a 667 MHz CPU clock).
```

## dts/bindings/usb/xlnx,zynq-usb.yaml
```yaml
# Copyright (c) 2017, I-SENSE group of ICCS
# SPDX-License-Identifier: Apache-2.0

description: Xilinx Zynq USB controller

compatible: "xlnx,zynq-usb"

include: [usb-ep.yaml, pinctrl-device.yaml]

bus: usb
 
```
