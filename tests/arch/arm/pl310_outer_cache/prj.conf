## CMakeLists.txt
```
# SPDX-License-Identifier: Apache-2.0
cmake_minimum_required(VERSION 3.20.0)
find_package(Zephyr REQUIRED HINTS $ENV{ZEPHYR_BASE})
project(pl310_outer_cache_test)
target_sources(app PRIVATE
  src/inner_edges.c
  src/main.c
  src/sequencing.c
)
```

## prj.conf
```kconfig
CONFIG_ZTEST=y
CONFIG_DCACHE=y
CONFIG_CACHE_MANAGEMENT=y
CONFIG_SOC_XLNX_ZYNQ7000_L2_CACHE=y
```

## src/main.c
```c
/*
 * Copyright (c) 2026 Opus One
 *
 * SPDX-License-Identifier: Apache-2.0
 */

/*
 * The PL310 outer cache against a fake controller: a 2 KiB buffer standing in
 * for the register window, so that the boot sequence, the by-way operations,
 * the line arithmetic and the virtual-to-physical translation can all be read
 * back and checked.  Every register this driver touches has its own offset, so
 * a plain buffer records the whole init sequence; a range operation writes one
 * register repeatedly, so what a buffer preserves there is the last line of
 * the range -- which is exactly the end of the arithmetic worth checking.
 */

#include <zephyr/ztest.h>
#include <zephyr/cache.h>
#include <zephyr/sys/device_mmio.h>
#include <zephyr/sys/util.h>
#include <zephyr/arch/arm/cortex_a_r/outer_cache.h>

#include "soc.h"

#define PL310_CTRL           0x100U
#define PL310_AUX_CTRL       0x104U
#define PL310_TAG_RAM_CTRL   0x108U
#define PL310_DATA_RAM_CTRL  0x10CU
#define PL310_CACHE_SYNC     0x730U
#define PL310_INV_PA         0x770U
#define PL310_INV_WAY        0x77CU
#define PL310_CLEAN_PA       0x7B0U
#define PL310_CLEAN_WAY      0x7BCU
#define PL310_CLEAN_INV_PA   0x7F0U
#define PL310_CLEAN_INV_WAY  0x7FCU

#define LINE 32U

static uint8_t fake[0x800] __aligned(4);
static uint8_t scratch[8192] __aligned(4096);

static uintptr_t saved_base;

static uint32_t reg(uint32_t off)
{
	uint32_t val;

	memcpy(&val, &fake[off], sizeof(val));
	return val;
}

static void use_fake(void)
{
	memset(fake, 0, sizeof(fake));
	zynq_pl310_base = (uintptr_t)fake;
}

static void *setup(void)
{
	saved_base = zynq_pl310_base;
	return NULL;
}

static void teardown(void *unused)
{
	ARG_UNUSED(unused);
	zynq_pl310_base = saved_base;
}

ZTEST(pl310_outer_cache, test_init_sequence)
{
	use_fake();

	zynq_pl310_init((uintptr_t)fake);

	zassert_equal(reg(PL310_AUX_CTRL), 0x72360000U,
		      "aux control: 8 ways of 64 KiB, prefetch, parity");
	zassert_equal(reg(PL310_TAG_RAM_CTRL), 0x00000111U, "tag RAM latency");
	zassert_equal(reg(PL310_DATA_RAM_CTRL), 0x00000121U, "data RAM latency");
	zassert_equal(reg(PL310_INV_WAY), 0x0000FFFFU, "all ways invalidated");
	zassert_equal(reg(PL310_CTRL), 1U, "controller enabled last");

	teardown(NULL);
}

/*
 * A by-way operation is complete when the way register itself reads zero.
 * The fake keeps the cache sync register at zero throughout, so a driver that
 * took that register for the completion indicator would return before the
 * way register was ever cleared -- and would then write the sync register
 * while the operation was still running, which the controller stalls.  A
 * timer clears the way register from interrupt context part way through the
 * poll; the operation must not have returned before that happened.
 */
static struct k_timer clear_way_timer;
static volatile bool way_cleared;

static void clear_way(struct k_timer *timer)
{
	ARG_UNUSED(timer);
	memset(&fake[PL310_CLEAN_WAY], 0, sizeof(uint32_t));
	way_cleared = true;
}

ZTEST(pl310_outer_cache, test_way_op_completes_via_way_register)
{
	use_fake();

	way_cleared = false;
	k_timer_init(&clear_way_timer, clear_way, NULL);
	k_timer_start(&clear_way_timer, K_MSEC(2), K_NO_WAIT);

	outer_cache_clean_all();

	zassert_true(way_cleared, "returned before the way register was cleared");

	k_timer_stop(&clear_way_timer);
	teardown(NULL);
}

/*
 * A way register that never clears must not trap the caller.  sys_reboot()
 * reaches the outer cache with interrupts locked and the system timer
 * stopped, so a reset would be lost forever behind an unbounded poll.
 */
ZTEST(pl310_outer_cache, test_way_op_poll_is_bounded)
{
	uint32_t poison = 0xDEADU;
	int64_t start;
	int64_t elapsed;

	use_fake();
	/* A cache sync only ever writes zero here, so a value that survives
	 * proves no sync was issued into a controller still claiming to be
	 * busy -- that write is what the controller stalls on.
	 */
	memcpy(&fake[PL310_CACHE_SYNC], &poison, sizeof(poison));

	start = k_uptime_get();
	outer_cache_flush_and_invd_all();
	elapsed = k_uptime_get() - start;

	zassert_equal(reg(PL310_CLEAN_INV_WAY), 0x0000FFFFU,
		      "way register was left as the hardware would report it");
	zassert_equal(reg(PL310_CACHE_SYNC), poison,
		      "no cache sync issued after the poll gave up");
	printk("bounded poll gave up after %lld ms\n", (long long)elapsed);
	zassert_true(elapsed < 5000, "poll bound is too loose to be a fail-safe");

	teardown(NULL);
}

ZTEST(pl310_outer_cache, test_way_operations)
{
	use_fake();
	zynq_pl310_base = (uintptr_t)fake;

	outer_cache_clean_all();
	zassert_equal(reg(PL310_CLEAN_WAY), 0x0000FFFFU, "clean by way");

	outer_cache_invd_all();
	zassert_equal(reg(PL310_INV_WAY), 0x0000FFFFU, "invalidate by way");

	outer_cache_flush_and_invd_all();
	zassert_equal(reg(PL310_CLEAN_INV_WAY), 0x0000FFFFU, "clean and invalidate by way");

	teardown(NULL);
}

/* An unaligned range must cover the line the first byte sits in and the line
 * the last byte sits in, and nothing past it.
 */
ZTEST(pl310_outer_cache, test_clean_range_line_arithmetic)
{
	uintptr_t start = (uintptr_t)scratch + 8U;
	size_t size = 100U;
	uintptr_t last_line = ROUND_DOWN(start + size - 1U, LINE);

	use_fake();

	outer_cache_clean_range((void *)start, size);

	zassert_equal(reg(PL310_CLEAN_PA), (uint32_t)last_line,
		      "last line of an unaligned clean range");

	/* A range that ends exactly on a line boundary must not reach into the
	 * next line.
	 */
	start = (uintptr_t)scratch;
	size = 2U * LINE;
	use_fake();
	outer_cache_clean_range((void *)start, size);
	zassert_equal(reg(PL310_CLEAN_PA), (uint32_t)(start + LINE),
		      "aligned range stops at its last line");

	teardown(NULL);
}

/* Invalidate keeps the partial lines at either end by cleaning them instead of
 * dropping them, and only the interior goes to the plain invalidate register.
 */
ZTEST(pl310_outer_cache, test_invd_range_partial_lines)
{
	uintptr_t start = (uintptr_t)scratch + 8U;
	size_t size = 100U;
	uintptr_t tail = ROUND_DOWN(start + size, LINE);
	uintptr_t head = ROUND_DOWN(start, LINE);

	use_fake();

	outer_cache_invd_range((void *)start, size);

	/* Head line first, tail line second: the tail is what survives. */
	zassert_equal(reg(PL310_CLEAN_INV_PA), (uint32_t)tail,
		      "unaligned tail line cleaned, not dropped");
	zassert_equal(reg(PL310_INV_PA), (uint32_t)(tail - LINE),
		      "interior runs up to, and not into, the tail line");
	zassert_not_equal(head, tail, "test range must straddle line boundaries");

	/* A line-aligned range uses the plain invalidate for every line. */
	use_fake();
	outer_cache_invd_range(scratch, 4U * LINE);
	zassert_equal(reg(PL310_CLEAN_INV_PA), 0U, "no partial lines to clean");
	zassert_equal(reg(PL310_INV_PA), (uint32_t)((uintptr_t)scratch + 3U * LINE),
		      "last line of an aligned invalidate range");

	teardown(NULL);
}

/* The range walk translates once per 4 KiB page; a range crossing a page
 * boundary must still end on its own last line.
 */
ZTEST(pl310_outer_cache, test_range_crosses_page)
{
	uintptr_t start = (uintptr_t)scratch + KB(4) - LINE;
	size_t size = 4U * LINE;

	use_fake();

	outer_cache_flush_and_invd_range((void *)start, size);

	zassert_equal(reg(PL310_CLEAN_INV_PA), (uint32_t)(start + size - LINE),
		      "last line of a range spanning two pages");

	teardown(NULL);
}

/*
 * The controller works on physical addresses.  Map a page of RAM a second
 * time, at a virtual address the MMU has to translate, and check that the
 * address handed to the controller is the physical one.
 */
ZTEST(pl310_outer_cache, test_virtual_to_physical)
{
	uintptr_t phys = (uintptr_t)scratch;
	mm_reg_t virt;

	device_map(&virt, phys, KB(4), K_MEM_CACHE_WB);
	zassert_not_equal((uintptr_t)virt, phys, "device_map must not return the identity VA");

	use_fake();

	outer_cache_clean_range((void *)(uintptr_t)virt, LINE);
	zassert_equal(reg(PL310_CLEAN_PA), (uint32_t)phys,
		      "aliased VA translated back to its physical address");

	outer_cache_clean_range((void *)((uintptr_t)virt + 3U * LINE), LINE);
	zassert_equal(reg(PL310_CLEAN_PA), (uint32_t)(phys + 3U * LINE),
		      "page offset preserved across the translation");

	teardown(NULL);
}

ZTEST_SUITE(pl310_outer_cache, NULL, setup, NULL, NULL, teardown);
```

## src/inner_edges.c
```c
/*
 * SPDX-FileCopyrightText: Copyright The Zephyr Project Contributors
 * SPDX-License-Identifier: Apache-2.0
 */

/* Exercise the actual L1/outer composition with delayed L1 writeback. */
#include <zephyr/ztest.h>
#include <zephyr/cache.h>
#include <zephyr/arch/arm/cortex_a_r/outer_cache.h>
#include <zephyr/sys/barrier.h>
#include <cmsis_core.h>

#define FIRST_LINE 0x1000U
#define LINE_SIZE  32U
#define NUM_LINES  4U

static bool inner_dirty[NUM_LINES];
static bool pending[NUM_LINES];
static bool invalidate_pending[NUM_LINES];
static bool outer_dirty[NUM_LINES];
static bool memory_saved[NUM_LINES];
static bool inner_valid[NUM_LINES];
static uint32_t inner_cleans[NUM_LINES];

static size_t line_index(void *address)
{
	size_t index = ((uintptr_t)address - FIRST_LINE) / LINE_SIZE;

	zassert_true(index < NUM_LINES);
	return index;
}

static void clean_inner(void *address)
{
	size_t index = line_index(address);

	inner_cleans[index]++;
	pending[index] |= inner_dirty[index];
	inner_dirty[index] = false;
}

static void invalidate_inner(void *address)
{
	size_t index = line_index(address);

	inner_dirty[index] = false;
	invalidate_pending[index] = true;
}

static void __unused clean_invalidate_inner(void *address)
{
	clean_inner(address);
	invalidate_inner(address);
}

static void complete_inner(void)
{
	for (size_t i = 0U; i < NUM_LINES; i++) {
		outer_dirty[i] |= pending[i];
		pending[i] = false;
		if (invalidate_pending[i]) {
			inner_valid[i] = false;
			invalidate_pending[i] = false;
		}
	}
}

static void invalidate_outer(void *address, size_t size)
{
	uintptr_t start = (uintptr_t)address;
	uintptr_t end = start + size;

	for (uintptr_t line = ROUND_DOWN(start, LINE_SIZE); line < end; line += LINE_SIZE) {
		size_t index = line_index((void *)line);

		/* PL310 preserves the partial edges, and drops aligned interior lines. */
		if (line < start || end < line + LINE_SIZE) {
			memory_saved[index] |= outer_dirty[index];
		}
		outer_dirty[index] = false;
	}
}

/* CMSIS range operations issue DMB; only a DSB completes the pending writeback. */
#define L1C_CleanDCacheMVA           clean_inner
#define L1C_InvalidateDCacheMVA      invalidate_inner
#define L1C_CleanInvalidateDCacheMVA clean_invalidate_inner
#define barrier_dsync_fence_full     complete_inner
#define outer_cache_invd_range       invalidate_outer
#undef read_sysreg
#define read_sysreg(reg)                 (3U << 16)
#define arch_dcache_line_size_get        edge_line_size_get
#define arch_dcache_enable               edge_enable
#define arch_dcache_disable              edge_disable
#define arch_dcache_flush_all            edge_flush_all
#define arch_dcache_invd_all             edge_invd_all
#define arch_dcache_flush_and_invd_all   edge_flush_and_invd_all
#define arch_dcache_flush_range          edge_flush_range
#define arch_dcache_invd_range           edge_invd_range
#define arch_dcache_flush_and_invd_range edge_flush_and_invd_range
#define arch_icache_enable               edge_icache_enable
#define arch_icache_disable              edge_icache_disable
#define arch_icache_flush_all            edge_icache_flush_all
#define arch_icache_invd_all             edge_icache_invd_all
#define arch_icache_flush_and_invd_all   edge_icache_flush_and_invd_all
#define arch_icache_flush_range          edge_icache_flush_range
#define arch_icache_invd_range           edge_icache_invd_range
#define arch_icache_flush_and_invd_range edge_icache_flush_and_invd_range
#define arch_cache_init                  edge_cache_init
int edge_icache_invd_all(void);
#include "../../../../../arch/arm/core/cortex_a_r/cache.c"

static void reset_edges(void)
{
	memset(inner_dirty, 0, sizeof(inner_dirty));
	memset(pending, 0, sizeof(pending));
	memset(invalidate_pending, 0, sizeof(invalidate_pending));
	memset(outer_dirty, 0, sizeof(outer_dirty));
	memset(memory_saved, 0, sizeof(memory_saved));
	memset(inner_cleans, 0, sizeof(inner_cleans));
	for (size_t i = 0U; i < NUM_LINES; i++) {
		inner_valid[i] = true;
	}
}

ZTEST(pl310_edges, test_partial_inner_lines_reach_memory_before_outer_invalidate)
{
	const struct {
		uint32_t offset;
		size_t size;
	} ranges[] = {
		{8U, 100U}, {0U, 100U}, {8U, 120U}, {3U, 2U}, {0U, 128U}, {3U, 0U},
	};

	for (size_t range = 0U; range < ARRAY_SIZE(ranges); range++) {
		uintptr_t start = FIRST_LINE + ranges[range].offset;
		uintptr_t end = start + ranges[range].size;

		reset_edges();
		for (size_t i = 0U; i < NUM_LINES; i++) {
			uintptr_t line = FIRST_LINE + i * LINE_SIZE;
			bool partial = ranges[range].size > 0U &&
				       ((line < start && start < line + LINE_SIZE) ||
					(line < end && end < line + LINE_SIZE));

			/* The dirty bytes represent CPU-owned data outside the requested range. */
			inner_dirty[i] = partial;
		}
		zassert_ok(edge_invd_range((void *)start, ranges[range].size));
		for (size_t i = 0U; i < NUM_LINES; i++) {
			uintptr_t line = FIRST_LINE + i * LINE_SIZE;
			bool covered =
				ranges[range].size > 0U && line < end && start < line + LINE_SIZE;
			bool partial = covered && (line < start || end < line + LINE_SIZE);

			zassert_equal(memory_saved[i], partial,
				      "adjacent CPU data never reached RAM");
			zassert_equal(inner_cleans[i], partial ? 1U : 0U,
				      "clean only the two edges, once per line");
			zassert_false(pending[i] || outer_dirty[i],
				      "writeback escaped outer maintenance");
			zassert_equal(inner_valid[i], !covered);
		}
	}
}

ZTEST_SUITE(pl310_edges, NULL, NULL, NULL, NULL, NULL);
```

## src/sequencing.c
```c
/*
 * SPDX-FileCopyrightText: Copyright The Zephyr Project Contributors
 * SPDX-License-Identifier: Apache-2.0
 */

/* Run the SoC implementation against a controller with dirty, busy ways. */
#include <zephyr/ztest.h>
#include <zephyr/cache.h>
#include <zephyr/arch/arm/cortex_a_r/outer_cache.h>
#include <zephyr/sys/barrier.h>
#include <zephyr/sys/sys_io.h>
#include <cmsis_core.h>
#include "soc.h"

static uint32_t control;
static uint32_t sctlr;
static uint32_t busy_reg;
static uint32_t busy_reads;
static bool stuck;
static bool l1_dirty;
static bool l2_dirty;
static bool drained;
static size_t reconfigurations;
static size_t debug_writes;

static uint32_t model_read(mem_addr_t address)
{
	uint32_t reg = address - ZYNQ_PL310_BASE;

	if (reg == 0x100U) {
		return control;
	}
	if (reg == busy_reg && busy_reads > 0U) {
		if (!stuck) {
			busy_reads--;
		}
		return 0xFFFFU;
	}
	return 0U;
}

static void model_write(uint32_t value, mem_addr_t address)
{
	uint32_t reg = address - ZYNQ_PL310_BASE;

	zassert_equal(busy_reads, 0U, "command issued while by-way operation is busy");
	if (reg == 0x100U) {
		zassert_false(l1_dirty || l2_dirty,
			      "controller disabled before dirty data drained");
		control = value;
	} else if (reg == 0x104U || reg == 0x108U || reg == 0x10CU) {
		zassert_equal(control, 0U, "configuration changed while L2 enabled");
		reconfigurations++;
	} else if (reg == 0x7FCU) {
		zassert_equal(sctlr & SCTLR_C_Msk, 0U, "L1 can refill L2 during warm init");
		zassert_false(l1_dirty, "dirty L1 never reached L2");
		busy_reg = reg;
		busy_reads = 2U;
	} else if (reg == 0x730U) {
		l2_dirty = false;
		drained = true;
	} else if (reg == 0x77CU) {
		zassert_false(l2_dirty, "invalidate discarded dirty bootloader data");
		busy_reg = reg;
		busy_reads = 2U;
	} else if (reg == 0xF40U) {
		debug_writes++;
	}
}

static void model_disable(void)
{
	l2_dirty |= l1_dirty;
	l1_dirty = false;
	sctlr &= ~SCTLR_C_Msk;
}

static void model_enable(void)
{
	zassert_equal(control, 1U, "L1 restored before L2 enabled");
	sctlr |= SCTLR_C_Msk;
}

/* Keep the real SoC instance, including ATS1CPR tests, linked alongside this one. */
#define sys_read32                       model_read
#define sys_write32                      model_write
#define __get_SCTLR()                    sctlr
#define arch_dcache_disable              model_disable
#define arch_dcache_enable               model_enable
#define zynq_pl310_base                  model_base
#define zynq_pl310_init                  model_init
#define outer_cache_clean_range          model_clean_range
#define outer_cache_invd_range           model_invd_range
#define outer_cache_flush_and_invd_range model_flush_and_invd_range
#define outer_cache_clean_all            model_clean_all
#define outer_cache_invd_all             model_invd_all
#define outer_cache_flush_and_invd_all   model_flush_and_invd_all
#include "../../../../../soc/xlnx/zynq7000/common/cache_pl310.c"

static void reset_model(bool l1_enabled)
{
	control = 1U;
	sctlr = l1_enabled ? SCTLR_C_Msk : 0U;
	l1_dirty = l1_enabled;
	l2_dirty = true;
	drained = false;
	busy_reg = 0U;
	busy_reads = 0U;
	reconfigurations = 0U;
	debug_writes = 0U;
	stuck = false;
}

ZTEST(pl310_sequence, test_warm_init_preserves_dirty_data_and_l1_state)
{
	for (uint32_t enabled = 0U; enabled < 2U; enabled++) {
		reset_model(enabled != 0U);
		model_init(ZYNQ_PL310_BASE);
		zassert_true(drained, "warm init did not drain dirty bootloader data");
		zassert_equal(control, 1U);
		zassert_equal(reconfigurations, 3U);
		zassert_equal(sctlr & SCTLR_C_Msk, enabled != 0U ? SCTLR_C_Msk : 0U);

		/* Re-entry must obey the same handoff, without a software-only guard. */
		l2_dirty = true;
		drained = false;
		model_init(ZYNQ_PL310_BASE);
		zassert_true(drained);
		zassert_equal(reconfigurations, 6U);
	}
}

ZTEST(pl310_sequence, test_warm_init_timeout_keeps_dirty_ways_enabled)
{
	reset_model(true);
	stuck = true;
	model_init(ZYNQ_PL310_BASE);
	zassert_false(drained);
	zassert_true(l2_dirty);
	zassert_equal(control, 1U);
	zassert_equal(sctlr & SCTLR_C_Msk, SCTLR_C_Msk);
	zassert_equal(reconfigurations, 0U);
}

ZTEST(pl310_sequence, test_r3p2_maintenance_does_not_write_debug_control)
{
	static uint8_t line[32] __aligned(32);

	reset_model(false);
	model_init(ZYNQ_PL310_BASE);
	drained = false;
	model_clean_range(line, sizeof(line));
	model_invd_range(line, sizeof(line));
	model_flush_and_invd_range(line, sizeof(line));
	model_clean_all();
	model_invd_all();
	model_flush_and_invd_all();
	zassert_true(drained, "maintenance still requires CACHE_SYNC completion");
	zassert_equal(debug_writes, 0U, "r3p2 needs no debug-register workaround");
}

ZTEST_SUITE(pl310_sequence, NULL, NULL, NULL, NULL, NULL);
```
