/* SPDX-FileCopyrightText: Copyright The Zephyr Project Contributors */
/* SPDX-License-Identifier: Apache-2.0 */
/ {
	axi_dma0: dma@40030000 {
		compatible = "xlnx,axi-dma-sg";
		reg = <0x40030000 0x10000>, <0x30000000 0x100000>, <0x30100000 0x100000>;
		reg-names = "regs", "tx_buf", "rx_buf";
		interrupts = <GIC_SPI 34 IRQ_TYPE_LEVEL IRQ_DEFAULT_PRIORITY>,
			     <GIC_SPI 35 IRQ_TYPE_EDGE IRQ_DEFAULT_PRIORITY>;
		#dma-cells = <1>;
		dma-channels = <2>;
		xlnx,addrwidth = <32>;
		xlnx,rx-outer-noncacheable;
	};
};
